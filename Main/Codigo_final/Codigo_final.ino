
/*---------------------------------- Defining Stuff... -------------------------------------------*/
#define cbi(sfr, bit) (_SFR_BYTE(sfr) &= ~_BV(bit))    /*------ This makes the analog inputs read faster --------*/
#define sbi(sfr, bit) (_SFR_BYTE(sfr) |= _BV(bit))


#include <Wire.h>      /*------ Library for display --------*/
#include <Tiny4kOLED.h>   /*------ Library for display --------*/
#include <HID-Project.h>  /*------ Library for commands to pc --------*/
#include <HID-Settings.h>  /*------ Library for commands to pc --------*/

#define CLK 4  /*------ Pinout for encoder --------*/
#define DATA 5

/*------ Timers --------*/
unsigned long previousMillis = 0;   /*------ Encoder ------*/
const long interval = 2000;
unsigned long previousMillis2 = 0;  /*------ Idle ------*/
const long interval2 = 3000;
unsigned long previousMillis3 = 0;  /*------ Animacion ------*/
const long interval3 = 600;
unsigned long previousMillis4 = 0;  /*------ Animacion Idle ------*/
const long interval4 = 600;


int updown = 0;   /*------ Lets me know if bongo should be up or down --------*/
int framex = 0;  /*------ Lets me know wich frame was last printed --------*/
static uint8_t prevNextCode = 0;
static uint16_t store=0;
bool rotating = false;
char caracter;

const int teclado0 = A0; 
const int teclado1 = A1; 
const int teclado2 = A2; 
const int teclado3 = A3; 

int presionado = 0;  /*------ Lets me know if im already pressing a key --------*/

int sensorValue0 = 0;
int sensorValue1 = 0;
int sensorValue2 = 0;
int sensorValue3 = 0;


/*---------------------------------- Animaciones -------------------------------------------*/


static const uint8_t BONGOIDLEDOWN[] PROGMEM = {
0x00, 0x00, 0x00, 0x00, 0x00, 0x00, 0x00, 0x00, 0x00, 0x00, 0x00, 0x00, 0x00, 0x00, 0x00, 0x00, 
0x00, 0x00, 0x00, 0x00, 0x00, 0x00, 0x00, 0x00, 0x00, 0x00, 0x00, 0x00, 0x00, 0x00, 0x00, 0x80, 
0x80, 0x40, 0x40, 0x20, 0x20, 0x10, 0x10, 0x08, 0x04, 0x02, 0x04, 0x08, 0x10, 0x20, 0x20, 0x40, 
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0x10, 0x20, 0x20, 0x23, 0x7c, 0x40, 0x40, 0x40, 0x80, 0x80, 0x80, 0x80  
};


static const uint8_t BONGOIDLEUP[] PROGMEM = {
0x00, 0x00, 0x00, 0x00, 0x00, 0x00, 0x00, 0x00, 0x00, 0x00, 0x00, 0x00, 0x00, 0x00, 0x00, 0x00, 
0x00, 0x00, 0x00, 0x00, 0x00, 0x00, 0x00, 0x00, 0x00, 0x00, 0x00, 0x00, 0x00, 0x00, 0x80, 0x40, 
0x40, 0x20, 0x20, 0x10, 0x10, 0x08, 0x08, 0x04, 0x02, 0x01, 0x02, 0x04, 0x08, 0x10, 0x10, 0x20, 
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0x10, 0x20, 0x20, 0x21, 0x7e, 0x40, 0x40, 0x40, 0x80, 0x80, 0x80, 0x80 
};


static const uint8_t BONGODERDOWN[] PROGMEM = {
0x00, 0x00, 0x00, 0x00, 0x00, 0x00, 0x00, 0x00, 0x00, 0x00, 0x00, 0x00, 0x00, 0x00, 0x00, 0x00, 
0x00, 0x00, 0x00, 0x00, 0x00, 0x00, 0x00, 0x00, 0x00, 0x00, 0x00, 0x00, 0x00, 0x00, 0x00, 0x80, 
0x80, 0x40, 0x40, 0x20, 0x20, 0x10, 0x10, 0x08, 0x04, 0x02, 0x04, 0x08, 0x10, 0x20, 0x20, 0x40, 
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0x10, 0x20, 0x20, 0x23, 0x7c, 0x40, 0x40, 0x40, 0x80, 0x80, 0x80, 0x80
};


static const uint8_t BONGODERUP[] PROGMEM = {
0x00, 0x00, 0x00, 0x00, 0x00, 0x00, 0x00, 0x00, 0x00, 0x00, 0x00, 0x00, 0x00, 0x00, 0x00, 0x00, 
0x00, 0x00, 0x00, 0x00, 0x00, 0x00, 0x00, 0x00, 0x00, 0x00, 0x00, 0x00, 0x00, 0x00, 0x80, 0x40, 
0x40, 0x20, 0x20, 0x10, 0x10, 0x08, 0x08, 0x04, 0x02, 0x01, 0x02, 0x04, 0x08, 0x10, 0x10, 0x20, 
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0x10, 0x20, 0x20, 0x21, 0x7e, 0x40, 0x40, 0x40, 0x80, 0x80, 0x80, 0x80
};


static const uint8_t BONGOIZQDOWN[] PROGMEM = {
0x00, 0x00, 0x00, 0x00, 0x00, 0x00, 0x00, 0x00, 0x00, 0x00, 0x00, 0x00, 0x00, 0x00, 0x00, 0x00, 
0x00, 0x00, 0x00, 0x00, 0x00, 0x00, 0x00, 0x00, 0x00, 0x00, 0x00, 0x00, 0x00, 0x00, 0x00, 0x80, 
0x80, 0x40, 0x40, 0x20, 0x20, 0x10, 0x10, 0x08, 0x04, 0x02, 0x04, 0x08, 0x10, 0x20, 0x20, 0x40, 
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0x80, 0x80, 0x80, 0x00, 0x11, 0x31, 0x31, 0x31, 0x30, 0x70, 0x70, 0x70, 0xf0, 0xf0, 0x20, 0x20
};


static const uint8_t BONGOIZQUP[] PROGMEM = {
0x00, 0x00, 0x00, 0x00, 0x00, 0x00, 0x00, 0x00, 0x00, 0x00, 0x00, 0x00, 0x00, 0x00, 0x00, 0x00, 
0x00, 0x00, 0x00, 0x00, 0x00, 0x00, 0x00, 0x00, 0x00, 0x00, 0x00, 0x00, 0x00, 0x00, 0x80, 0x40, 
0x40, 0x20, 0x20, 0x10, 0x10, 0x08, 0x08, 0x04, 0x02, 0x01, 0x02, 0x04, 0x08, 0x10, 0x10, 0x20, 
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0x80, 0x80, 0x80, 0x00, 0x11, 0x31, 0x31, 0x31, 0x30, 0x70, 0x70, 0x70, 0xf0, 0xf0, 0x20, 0x20,
};



/*----------------------------- Voids Print Animations --------------------------------------*/


void PRINTBONGOIDLEDOWN() {
oled.clear();
oled.bitmap(22, 0, 22  + 75, 4, BONGOIDLEDOWN);     /*------ The display is 128x32. This frame es 75 pixels wide en 32 high (for that you write 4 instead of 32. The other 22, 0 and 22 are for position.)  --------*/
oled.switchFrame();
framex = 1;
  }

void PRINTBONGOIDLEUP() {
oled.clear();
oled.bitmap(22, 0, 22  + 75, 4, BONGOIDLEUP);
oled.switchFrame();
framex = 2;
  }

void PRINTBONGODERDOWN() {
oled.clear();
oled.bitmap(22, 0, 22  + 75, 4, BONGODERDOWN);
oled.switchFrame();
framex = 3;
  }

void PRINTBONGODERUP() {
oled.clear();
oled.bitmap(22, 0, 22  + 75, 4, BONGODERUP);
oled.switchFrame();
framex = 4;
  }

void PRINTBONGOIZQDOWN() {
oled.clear();
oled.bitmap(22, 0, 22  + 88, 4, BONGOIZQDOWN);
oled.switchFrame();
framex = 5;
  }

void PRINTBONGOIZQUP() {
oled.clear();
oled.bitmap(22, 0, 22  + 88, 4, BONGOIZQUP);
oled.switchFrame();
framex = 6;
  }



/*----------------------------- Void Read del Encoder --------------------------------------*/

int8_t read_rotary() {
  static int8_t rot_enc_table[] = {0,1,1,0,1,0,0,1,1,0,0,1,0,1,1,0};

  prevNextCode <<= 2;
  if (digitalRead(DATA)) prevNextCode |= 0x02;
  if (digitalRead(CLK)) prevNextCode |= 0x01;
  prevNextCode &= 0x0f;

   if  (rot_enc_table[prevNextCode] ) {
      store <<= 4;
      store |= prevNextCode;
      if ((store&0xff)==0x2b) return -1;
      if ((store&0xff)==0x17) return 1;
   }
   return 0;
}

/*---------------------------------------- Setup ----------------------------------------------*/


void setup() {

  Serial.begin(9600);
  pinMode(CLK, INPUT);
  pinMode(CLK, INPUT_PULLUP);
  pinMode(DATA, INPUT);
  pinMode(DATA, INPUT_PULLUP);
  Consumer.begin();
  pinMode(7, OUTPUT);
  pinMode(10, OUTPUT);
  digitalWrite(7, HIGH);
  digitalWrite(10, HIGH);
  oled.begin();
  oled.clear();
  oled.on();
  oled.switchRenderFrame();


  sbi(ADCSRA, ADPS2);    /*------ Some lines needed to make it read faster analogs --------*/
  cbi(ADCSRA, ADPS1);
  cbi(ADCSRA, ADPS0);
  
}


/*---------------------------------------- Loop ----------------------------------------------*/


void loop() {

/*------- Read encoder and send commands ---------*/

/*------ Printing at the same time you read the encoder and send commands causes it lo lag,
so whenever im using the econder, the code stops printing and gets stuck in the "while" loop
until 2 seconds pass--------*/



static int8_t c,val, val2;
unsigned long a;
val=0;



   if( val=read_rotary() ) {             /*------ You used the encoder and activated the timer for the first time --------*/
      
      unsigned long currentMillis = 0;
      previousMillis = millis();

      if ( prevNextCode==0x0b) {
        Consumer.write(MEDIA_VOLUME_UP);
      }

      if ( prevNextCode==0x07) {
         Consumer.write(MEDIA_VOLUME_DOWN);
      }

      while (currentMillis < interval){       /*------ will be in the loop por whatever time you define on "interval" variable --------*/
         a = millis();
         currentMillis = a - previousMillis;
        val2=0;
         if( val2=read_rotary() ) {            /*------ If you used the encoder again during this 2 seconds i defines on "interval", then it resets the timer and waits 2 second again --------*/
             
      
          if ( prevNextCode==0x0b) {
             Consumer.write(MEDIA_VOLUME_UP);
          }

          if ( prevNextCode==0x07) {
             Consumer.write(MEDIA_VOLUME_DOWN);
          }
          currentMillis = 0;          
          
          }


          }

      }  


/*------- Configuration for Aniamtions ---------*/

/*------ We use this for timers. To know how timers work, check file - examples - digital - BlinkWithoutDelay.
 We use 3 variables for each timer: currentMillis, previousMillis and interval. The numbers define wich timer it is
 Timer 1 is for the 2 seconds on the encoder
 Timer 2 is for Going back to idle mode if i dont type for a few seconds
 timer 3 and 4 are the same thing, they make it go up and down every half a second--------*/

  unsigned long currentMillis2 = millis();
  unsigned long currentMillis3 = millis();
  unsigned long currentMillis4 = millis();
  
  sensorValue0 = analogRead(teclado0);  /*------ Store the value of analog inputs --------*/
  sensorValue1 = analogRead(teclado1);
  sensorValue2 = analogRead(teclado2);
  sensorValue3 = analogRead(teclado3);



      if ((sensorValue2<40)&&presionado == 1)   
      {
        presionado = 0;
         
        }

/*------ There are 2 cases where i need to make it go up and down. One is when i press a key i need to knwo if amma pritn it up or down
and the other is passive, its when it has an arm down, i dont press anything, but it still changes between up and down--------*/

      if ((sensorValue2>200)&&presionado == 0)    /*------ Ask if i am pressing any of the inputs (im actually aking for just one but it works better than asking for all of them idk why) --------*/
      {
        presionado = 1;     
        previousMillis2 = currentMillis2;      /*------ I pressed a key, so we restart the timer 2 that makes it go into idle --------*/


        if (updown==0)                       /*------ Should i print the one down... --------*/
        {
          if (framex==3){
            PRINTBONGOIZQDOWN();
          }
          else PRINTBONGODERDOWN();          
          }

        if (updown==1)                      /*------ or the one up? --------*/
        {
          if (framex==4){
            PRINTBONGOIZQUP();
          }
          else PRINTBONGODERUP();          
          }

        }




        if (currentMillis3 - previousMillis3 >= interval3) {    /*------ This is the passive timer that makes it go up and down --------*/

           previousMillis3 = currentMillis3;
           
              if (updown==1)
              {
                updown=0;
              }
              else updown=1;


          switch (framex) {                /*------ If im here its because its time to switch between up and down, so i ask: is framex == 3? if so, then its down, so print the one that is up, and so on... --------*/
            
            case 3:
                 PRINTBONGODERUP();
                 break;
            case 4:
                 PRINTBONGODERDOWN();
                 break;
            case 5:
                 PRINTBONGOIZQUP();
                 break;
            case 6:
                 PRINTBONGOIZQDOWN();
                 break;
            
            }

            }
        
/*------------------ Modo Idle ------------------*/


  if (currentMillis2 - previousMillis2 >= interval2) {               /*------ If its time to go to idle, it goes in here --------*/

      if (currentMillis4 - previousMillis4 >= interval4) {            /*------ If its time to switch between up or down, then go here --------*/
        
      
        if (framex==1){
        PRINTBONGOIDLEUP();
        }
        else PRINTBONGOIDLEDOWN();
        
        previousMillis4 = currentMillis4;
        
       }

}

  
  Serial.println(sensorValue3);                                 /*------ This was just for debugging --------*/



     
}
     






 
